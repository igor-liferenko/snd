typedef float Float16;

typedef unsigned char U8 ;
typedef unsigned short U16;
typedef unsigned long U32;
typedef signed char S8 ;
typedef signed short S16;
typedef long S32;



typedef unsigned char Bool;


typedef U8 Status;
typedef Bool Status_bool;
typedef unsigned char Uchar;


typedef unsigned char Uint8;
typedef unsigned int Uint16;
typedef unsigned long int Uint32;

typedef char Int8;
typedef int Int16;
typedef long int Int32;

typedef unsigned char Byte;
typedef unsigned int Word;
typedef unsigned long int DWord;

typedef union
{
  Uint32 dw;
  Uint16 w[2];
  Uint8 b[4];
} Union32;

typedef union
{
  Uint16 w;
  Uint8 b[2];
} Union16;
typedef char p_uart_ptchar;
typedef char r_uart_ptchar;
#include  <avr/interrupt.h>
#include  <avr/pgmspace.h>
#include  <avr/io.h>
U8 flash_read_sig(unsigned long adr);







U8 flash_read_fuse(unsigned long adr);
   U16 Get_adc_mic_val(void);
   U16 Get_adc_temp_val(void);
   S16 Read_temperature(void);
extern void suspend_action(void);
typedef enum endpoint_parameter{ep_num, ep_type, ep_direction, ep_size, ep_bank, nyet_status} t_endpoint_parameter;
U8 usb_config_ep (U8, U8);
U8 usb_select_enpoint_interrupt (void);
U16 usb_get_nb_byte_epw (void);
U8 usb_send_packet (U8 , U8*, U8);
U8 usb_read_packet (U8 , U8*, U8);
void usb_halt_endpoint (U8);
void usb_reset_endpoint (U8);
U8 usb_init_device (void);
void init_adc(void);
extern volatile U16 g_usb_event;
extern U8 g_usb_mode;
extern U8 usb_remote_wup_feature;
void usb_task_init (void);
void usb_task (void);

extern volatile U8 private_sof_counter;
void usb_process_request( void);










void usb_generate_remote_wakeup(void);

extern U8 usb_configuration_nb;
extern U8 remote_wakeup_feature;
typedef struct
{
   U8 bmRequestType;
   U8 bRequest;
   U16 wValue;
   U16 wIndex;
   U16 wLength;
} S_UsbRequest;



typedef struct {
   U8 bLength;
   U8 bDescriptorType;
   U16 bscUSB;
   U8 bDeviceClass;
   U8 bDeviceSubClass;
   U8 bDeviceProtocol;
   U8 bMaxPacketSize0;
   U16 idVendor;
   U16 idProduct;
   U16 bcdDevice;
   U8 iManufacturer;
   U8 iProduct;
   U8 iSerialNumber;
   U8 bNumConfigurations;
} S_usb_device_descriptor;



typedef struct {
   U8 bLength;
   U8 bDescriptorType;
   U16 wTotalLength;
   U8 bNumInterfaces;
   U8 bConfigurationValue;
   U8 iConfiguration;
   U8 bmAttibutes;
   U8 MaxPower;
} S_usb_configuration_descriptor;



typedef struct {
   U8 bLength;
   U8 bDescriptorType;
   U8 bInterfaceNumber;
   U8 bAlternateSetting;
   U8 bNumEndpoints;
   U8 bInterfaceClass;
   U8 bInterfaceSubClass;
   U8 bInterfaceProtocol;
   U8 iInterface;
} S_usb_interface_descriptor;




typedef struct {
   U8 bLength;
   U8 bDescriptorType;
   U8 bDescritorSubtype;
   U16 bcdADC;
   U16 wTotalLength;
   U8 bInCollection;
   U8 baInterface1;
   U8 baInterface2;
} S_usb_ac_interface_descriptor;


typedef struct{
   U8 bLenght;
   U8 bDescriptorType;
   U8 bDescriptorSubType;
   U8 bTerminalID;
   U16 wTerminalType;
   U8 bAssocTerminal;
   U8 bNrChannels;
   U16 wChannelConfig;
   U8 iChannelNames;
   U8 iTerminal;
} S_usb_in_ter_descriptor;


typedef struct{
   U8 bLenght;
   U8 bDescriptorType;
   U8 bDescriptorSubType;
   U8 bUnitID;
   U8 bSourceID;
   U8 bControSize;
   U8 bmaControlMaster;
   U8 bmaControlCh1;
} S_usb_feature_unit_descriptor_speaker;


typedef struct{
   U8 bLenght;
   U8 bDescriptorType;
   U8 bDescriptorSubType;
   U8 bUnitID;
   U8 bSourceID;
   U8 bControSize;
   U8 bmaControlMaster;
   U8 bmaControlCh1;
} S_usb_feature_unit_descriptor_micro;


typedef struct{
   U8 bLenght;
   U8 bDescriptorType;
   U8 bDescriptorSubType;
   U8 bTerminalID;
   U16 wTerminalType;
   U8 bAssocTerminal;
   U8 bSourceID;
   U8 iTerminal;
} S_usb_out_ter_descriptor;


typedef struct{
   U8 bLenght;
   U8 bDescriptorType;
   U8 bDescriptorSubType;
   U8 bTerminalLink;
   U8 bDelay;
   U16 wFormatTag;
} S_usb_as_interface_descriptor;


typedef struct{
   U8 bLenght;
   U8 bDescriptorType;
   U8 bDescriptorSubType;
   U8 bFormatType;
   U8 bNrChannels;
   U8 bSubFrameSize;
   U8 bBitResolution;
   U8 bSampleFreqType;
   U16 wLsbyteiSamFreq;
   U8 bMsbyteiSamFreq;
} S_usb_format_type;


typedef struct{
   U8 bLenght;
   U8 bDescriptorType;
   U8 bDescriptorSubType;
   U8 bmAttributes;
   U8 bLockDelayUnits;
   U16 wLockDelay;
}S_usb_endpoint_audio_specific;


typedef struct {
   U8 bLength;
   U8 bDescriptorType;
   U8 bEndpointAddress;
   U8 bmAttributes;
   U16 wMaxPacketSize;
   U8 bInterval;
   U8 bRefresh;
   U8 bSynAddress;
} S_usb_endpoint_audio_descriptor;


typedef struct {
   U8 bLength;
   U8 bDescriptorType;
   U8 bEndpointAddress;
   U8 bmAttributes;
   U16 wMaxPacketSize;
   U8 bInterval;
} S_usb_endpoint_descriptor;



typedef struct {
   U8 bLength;
   U8 bDescriptorType;
   U16 bscUSB;
   U8 bDeviceClass;
   U8 bDeviceSubClass;
   U8 bDeviceProtocol;
   U8 bMaxPacketSize0;
   U8 bNumConfigurations;
   U8 bReserved;
} S_usb_device_qualifier_descriptor;



typedef struct {
   U8 bLength;
   U8 bDescriptorType;
   U16 wlangid;
} S_usb_language_id;






typedef struct {
   U8 bLength;
   U8 bDescriptorType;
   U16 wstring[ 5 ];
} S_usb_manufacturer_string_descriptor;






typedef struct {
   U8 bLength;
   U8 bDescriptorType;
   U16 wstring[ 18 ];
} S_usb_product_string_descriptor;






typedef struct {
   U8 bLength;
   U8 bDescriptorType;
   U16 wstring[ 0x05 ];
} S_usb_serial_number;




typedef struct
{
   S_usb_configuration_descriptor cfg;
   S_usb_interface_descriptor ifc;
   S_usb_ac_interface_descriptor audioac;
   S_usb_in_ter_descriptor speaker_in_ter;
   S_usb_feature_unit_descriptor_speaker speaker_fea_unit;
   S_usb_out_ter_descriptor speaker_out_ter;
   S_usb_in_ter_descriptor mic_in_ter;
   S_usb_feature_unit_descriptor_micro mic_fea_unit;
   S_usb_out_ter_descriptor mic_out_ter;
   S_usb_interface_descriptor speaker_as_alt0;
   S_usb_interface_descriptor speaker_as_alt1;
   S_usb_as_interface_descriptor speaker_g_as;
   S_usb_format_type speaker_format_type;
   S_usb_endpoint_audio_descriptor speaker_ep1;
   S_usb_endpoint_audio_specific speaker_ep1_s;
   S_usb_interface_descriptor mic_as_alt0;
   S_usb_interface_descriptor mic_as_alt1;
   S_usb_as_interface_descriptor mic_g_as;
   S_usb_format_type mic_format_type;
   S_usb_endpoint_audio_descriptor mic_ep1;
   S_usb_endpoint_audio_specific mic_ep1_s;
} S_usb_user_configuration_descriptor;
const  PROGMEM  unsigned char sample_sound[]=
   {
  0x31,0x00,0x22,0x00,0x39,0x00,0x3f,0x00,0x5a,0x00,0x6a,0x00,0x73,0x00,0x91,0x00,0x85,
  0x00,0xb5,0x00,0xd1,0x00,0xd9,0x00,0xfb,0x00,0x34,0x01,0x1b,0x01,0x53,0x01,0x9a,0x01,
  0x72,0x01,0x51,0x01,0x27,0x01,0x03,0x01,0x9b,0x00,0x71,0x00,0x03,0x00,0x9f,0xff,0x6e,
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  0xfa,0x00,0x1c,0x01,0x04,0x01,0xf4,0x00,0xce,0x00,0xac,0x00,0x85,0x00,0x6e,0x00,0x58};
extern U8 timer8_get_counter(void);
extern U16 timer16_get_counter(void);
extern U16 timer16_get_capture(void);
extern U16 timerhs_get_counter(void);
extern U16 timerhs_get_capture(void);






U16 Get_adc_ext_val(void);







U8  b_speaker_mute;


S16 s16_speaker_volume;



U8 g_buffer_speaker[ 0x400 ];
U8 *ptr_speaker_data_wr;
U8 *ptr_speaker_data_rd;




U8  b_micro_mute;




S16 s16_micro_volume;



U16 g_u16_micro_sample_pos=0;
void audio_task_init(void)
{
   {DDRC &= ~0x40; PORTC |= 0x40; if(! (0==( ( flash_read_fuse(0x0003)) &(1<< 6 ))) ) {DDRF &= ~0xF0; PORTF |= 0xF0;}} ;
   (DDRE &= ~(1<<PINE2), PORTE |= (1<<PINE2)) ;
   init_adc();

   ptr_speaker_data_wr = g_buffer_speaker;
   ptr_speaker_data_rd = g_buffer_speaker;







   ( TCCR0A = (TCCR0A & (~ ( (1<<WGM00) | (1<<WGM01) ) )) | ( ((( (2) & 0x02) >> 1) << WGM01) | (( (2) & 0x1) << WGM00) ) ) ;
   ( ( OCR0A = 120 ) ) ;
   ( TCCR0B = (TCCR0B & (~ (7<<CS00) )) | ( (2) << CS00) ) ;
   ( ( TIMSK0 |= (1<<OCIE0A) ) ) ;
   (PLLFRQ&=~ ( (1<<PLLTM1) | (1<<PLLTM0) ) ,PLLFRQ|= ( (1<<PLLTM1) | (0<<PLLTM0) ) ) ;
   ( TCCR4B=0, TCCR4A=0, TCCR4C=0, TCCR4D=0, TCCR4E=0,TC4H=0, TCNT4= 0, TC4H=0, OCR4A=0, TC4H=0, OCR4B=0, TC4H=0, OCR4D=0 ) ;
   ( TCCR4D = (TCCR4A & (~((1<<WGM41)|(1<<WGM40)))) | (( (0) & 0x3) )) ;
   ( TC4H = ((U16)(((U16)((1<<10)-1))>>8)), OCR4C = ((U8)((U16)((1<<10)-1)))) ;
   (DDRD|=0x80, TCCR4C |= (1<< 3 ), TCCR4C |= (1<<PWM4D)) ;
   ( TCCR4B = (TCCR4B & (~ ((1<<CS43) | (1<<CS42) |(1<<CS41) |(1<<CS40) ) )) | ( (1) ) ) ;


   ( TCCR1A = (TCCR1A & (~ (3<<WGM10) )) | (( (4) & 0x3) << WGM10), TCCR1B = (TCCR1B & (~ (3<<WGM12) )) | (( (4) >> 0x2) << WGM12) ) ;
   ( OCR1AH = ((U8)( 249 >>8)), OCR1AL = ((U8)( 249 ))) ;
   ( TCCR1B = (TCCR1B & (~ (7<<CS10) )) | ( (1) << CS10) ) ;
   ( TIMSK1 |= (1<<OCIE1A) ) ;


   b_speaker_mute =  (0==1) ;
   b_micro_mute =  (0==1) ;
   s16_speaker_volume=  9 ;
   s16_micro_volume =  0x7000 ;
}




void audio_task(void)
{
   Bool b_endpoint_no_empty =  (0==1) ;

   if( ! ((usb_configuration_nb!=0) ? (1==1) : (0==1) )  )
     return;


   if( ptr_speaker_data_wr < ptr_speaker_data_rd )
   {
      if(  249  ==  ( OCR1A )  )
      {
         if( ( 0x400 *1/8)>((U16)ptr_speaker_data_wr+((U16) 0x400 -(U16)ptr_speaker_data_rd)) )
         {
            ( OCR1AH = ((U8)( 251 >>8)), OCR1AL = ((U8)( 251 ))) ;
         }
      }else{
         if( ( 0x400 *7/8)<((U16)ptr_speaker_data_wr+((U16) 0x400 -(U16)ptr_speaker_data_rd)) )
         {
            ( OCR1AH = ((U8)( 249 >>8)), OCR1AL = ((U8)( 249 ))) ;
         }
      }
   }
   else
   {
      if(  249  ==  ( OCR1A )  )
      {
         if( ( 0x400 *1/8)>(ptr_speaker_data_wr-ptr_speaker_data_rd) )
         {
            ( OCR1AH = ((U8)( 251 >>8)), OCR1AL = ((U8)( 251 ))) ;
         }
      }else{
         if( ( 0x400 *7/8)>(ptr_speaker_data_wr-ptr_speaker_data_rd) )
         {
            ( OCR1AH = ((U8)( 249 >>8)), OCR1AL = ((U8)( 249 ))) ;
         }
      }
   }


   (UENUM = (U8) 1 ) ;
   if(! (UEINTX&(1<<RXOUTI)) )
      return;
   while ( ((U8)(UEBCLX)) !=0)
   {
      b_endpoint_no_empty =  (1==1) ;
      *ptr_speaker_data_wr++ =  (UEDATX) ;
      *ptr_speaker_data_wr++ =  (UEDATX) ;
      if( ptr_speaker_data_wr == (g_buffer_speaker+ 0x400 ) )
         ptr_speaker_data_wr = g_buffer_speaker;
   }

   if( b_endpoint_no_empty )
   {
      (UEINTX &= ~(1<<FIFOCON)) ;
   }

}










 ISR(TIMER0_COMPA_vect)
{
   S16 sample;
   U8 sav_ep;

   if(! ((usb_configuration_nb!=0) ? (1==1) : (0==1) ) )
      return;

   sav_ep= (UENUM ) ;
   (UENUM = (U8) 2 ) ;
   if(! (UEINTX&(1<<RWAL)) )
   {
      (UENUM = (U8)sav_ep ) ;
      return;
   }

   if( (b_micro_mute ==  (0==1) )
   && (s16_micro_volume > 0 ) )
   {

      if(  ((PINC & (1<<PINC6)) ? (0==1) : (1==1) )  )
      {


         (((U8* )&sample)[0])  = pgm_read_byte_near(&sample_sound[g_u16_micro_sample_pos++]);
         (((U8* )&sample)[1])  = pgm_read_byte_near(&sample_sound[g_u16_micro_sample_pos++]);
         if (g_u16_micro_sample_pos >  sizeof(sample_sound) )
            g_u16_micro_sample_pos=0;
      }
      else if(  ( (0==( ( flash_read_fuse(0x0003)) &(1<< 6 ))) || (PINF & (1<<PINF6)) ? (0==1) : (1==1) )  ||  ( (0==( ( flash_read_fuse(0x0003)) &(1<< 6 ))) || (PINF & (1<<PINF5)) ? (0==1) : (1==1) )  )
      {

         sample = (S32) (64*Get_adc_ext_val()-0x8000);
      }
      else
      {


         sample = (S32) (64*(Get_adc_mic_val()>>(7-( (((U8* )&s16_micro_volume)[1]) >>4)))-0x8000);
      }

      (UEDATX = (U8) (((U8* )&sample)[0]) ) ;
      (UEDATX = (U8) (((U8* )&sample)[1]) ) ;
   }
   else
   {

      (UEDATX = (U8)0) ;
      (UEDATX = (U8)0) ;
   }


   if ( ((U8)(UEBCLX)) == 16 )
   {
      (UEINTX &= ~(1<<FIFOCON)) ;
   }
   (UENUM = (U8)sav_ep ) ;
}







U16 Get_adc_ext_val(void)
{
   ( ( (ADMUX &= ~((1<<MUX4)|(1<<MUX3)|(1<<MUX2)|(1<<MUX1)|(1<<MUX0)), ADCSRB &= ~(1<<MUX5) ) , ADMUX |= (0x25& ((1<<MUX4)|(1<<MUX3)|(1<<MUX2)|(1<<MUX1)|(1<<MUX0)) ), ADCSRB |= (0x25>>5)<<MUX5 ) , (ADCSRA |= (1<<ADSC) ) ) ;
   while (! ((ADCSRA & (1<<ADIF)) ? (1==1) : (0==1) ) );
   return (U16)(ADCL+((U16)(ADCH<<8)));
}









 ISR(TIMER1_COMPA_vect)
{
   U16 sample;

   if(! ((usb_configuration_nb!=0) ? (1==1) : (0==1) ) )
   {

      ( TC4H = ((U8)((0)>>8)), OCR4D = ((U8)(0))) ;
      return;
   }


   if( b_speaker_mute )
   {
      ( TC4H = ((U8)((0x400/4)>>8)), OCR4D = ((U8)(0x400/4))) ;
      return;
   }


   if( ptr_speaker_data_wr == ptr_speaker_data_rd )
      return;
   (((U8* )&sample)[0])  = *ptr_speaker_data_rd++;
   (((U8* )&sample)[1])  = *ptr_speaker_data_rd++;
   if( ptr_speaker_data_rd == (g_buffer_speaker+ 0x400 ) )
      ptr_speaker_data_rd = g_buffer_speaker;






   ( TC4H = ((U8)(((((U16)sample+0x8000)>>7)>>(9-(U8)s16_speaker_volume))>>8)), OCR4D = ((U8)((((U16)sample+0x8000)>>7)>>(9-(U8)s16_speaker_volume)))) ;
}
